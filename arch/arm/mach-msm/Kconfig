## drivers/video/msm/Kconfig
```kconfig
source "drivers/video/msm/vidc/Kconfig"
source "drivers/video/msm/mhl_v2/Kconfig"

config FB_MSM
	tristate "MSM Framebuffer support"
	depends on FB && ARCH_MSM
	select FB_BACKLIGHT if FB_MSM_BACKLIGHT
	select NEW_LEDS
	select LEDS_CLASS
	select FB_CFB_FILLRECT
	select FB_CFB_COPYAREA
	select FB_CFB_IMAGEBLIT
	select SYNC
	select SW_SYNC
	

if FB_MSM

config FB_MSM_BACKLIGHT
	bool "Support for backlight control"
	default y
	

config FB_MSM_LOGO
	bool "MSM Frame Buffer Logo"
	default n
	

config FB_MSM_LCDC_HW
	bool
	default n

config FB_MSM_TRIPLE_BUFFER
	bool "Support for triple frame buffer"
	default n

config FB_MSM_MDP_HW
	bool
	default n

config FB_MSM_MDSS_COMMON
	bool

choice
	prompt "MDP HW version"
	default FB_MSM_MDP22

config FB_MSM_MDP22
	select FB_MSM_MDP_HW
	bool "MDP HW ver2.2"
	

config FB_MSM_MDP30
	select FB_MSM_LCDC_HW
	bool "MDP HW ver3.0"
	

config FB_MSM_MDP303
	depends on FB_MSM_MDP30
	select FB_MSM_MDP_HW
	bool "MDP HW ver3.03"
	default n


config FB_MSM_MDP31
	select FB_MSM_LCDC_HW
	select FB_MSM_MDP_HW
	bool "MDP HW ver3.1"
	

config FB_MSM_MDP40
	select FB_MSM_LCDC_HW
	select FB_MSM_MDP_HW
	bool "MDP HW ver4.0"
	

config FB_MSM_MDSS
	bool "MDSS HW"
	select FB_MSM_MDSS_COMMON
	

config FB_MSM_MDP_NONE
	bool "MDP HW None"
	

endchoice

config FB_MSM_QPIC
	bool
	select FB_MSM_MDSS_COMMON

config FB_MSM_EBI2
	bool
	default n

config FB_MSM_MDDI
	bool
	default n

config FB_MSM_MIPI_DSI
	bool
	default n

config FB_MSM_LCDC
	bool
	default n

config FB_MSM_LVDS
	bool
	default n

config FB_MSM_OVERLAY
	depends on FB_MSM_MDP40
	bool "MDP4 overlay support"
	default n

config FB_MSM_DTV
	depends on FB_MSM_OVERLAY
	bool
	default n

config FB_MSM_EXTMDDI
	bool
	default n

config FB_MSM_TVOUT
	bool
	default n

config FB_MSM_MDDI_TOSHIBA_COMMON
	bool
	select FB_MSM_MDDI
	default n

config FB_MSM_MDDI_TOSHIBA_COMMON_VGA
	bool
	select FB_MSM_MDDI_TOSHIBA_COMMON
	default n

config FB_MSM_MDDI_ORISE
	bool
	select FB_MSM_MDDI
	default n

config FB_MSM_MDDI_QUICKVX
	bool
	select FB_MSM_MDDI
	default n

config FB_MSM_MDDI_AUTO_DETECT
	bool
	select FB_MSM_MDDI
	default n

config FB_MSM_LCDC_AUTO_DETECT
	bool
	select FB_MSM_LCDC
	default n

config FB_MSM_LCDC_PANEL
	bool
	select FB_MSM_LCDC
	default n

config FB_MSM_MIPI_DSI_TOSHIBA
	bool
	select FB_MSM_MIPI_DSI
	default n

config FB_MSM_MIPI_DSI_RENESAS
	bool
	select FB_MSM_MIPI_DSI
	default n

config FB_MSM_MIPI_DSI_TRULY
	bool
	select FB_MSM_MIPI_DSI

config FB_MSM_MIPI_DSI_SIMULATOR
	bool
	select FB_MSM_MIPI_DSI
	default n

config FB_MSM_MIPI_DSI_NOVATEK
        bool
        select FB_MSM_MIPI_DSI
        default n

config FB_MSM_MIPI_DSI_NT35510
	bool
	select FB_MSM_MIPI_DSI

config FB_MSM_MIPI_DSI_ORISE
        bool
        select FB_MSM_MIPI_DSI
        default n

config FB_MSM_MIPI_DSI_NT35516
	bool
	select FB_MSM_MIPI_DSI

config FB_MSM_MIPI_DSI_TC358764_DSI2LVDS
	bool
	select FB_MSM_MIPI_DSI
	

config FB_MSM_LCDC_ST15_WXGA
    bool
    select FB_MSM_LCDC_PANEL
    default n

config FB_MSM_LCDC_ST15_PANEL
    depends on FB_MSM_LCDC_HW
    bool "LCDC ST1.5 Panel"
    select FB_MSM_LCDC_ST15_WXGA
    

config FB_MSM_LCDC_PRISM_WVGA
	bool
	select FB_MSM_LCDC_PANEL
	default n

config FB_MSM_LCDC_SAMSUNG_WSVGA
	bool
	select FB_MSM_LCDC_PANEL
	default n

config FB_MSM_LCDC_CHIMEI_WXGA
	bool
	select FB_MSM_LCDC_PANEL
	default n

config FB_MSM_LCDC_GORDON_VGA
	bool
	select FB_MSM_LCDC_PANEL
	default n

config FB_MSM_LCDC_TOSHIBA_WVGA_PT
	bool
	select FB_MSM_LCDC_PANEL
	default n

config FB_MSM_LCDC_TOSHIBA_FWVGA_PT
	bool
	select FB_MSM_LCDC_PANEL
	default n

config FB_MSM_LCDC_SHARP_WVGA_PT
	bool
	select FB_MSM_LCDC_PANEL
	default n

config FB_MSM_LCDC_AUO_WVGA
	bool
	select FB_MSM_LCDC_PANEL
	default n

config FB_MSM_LCDC_TRULY_HVGA_IPS3P2335
        bool
        select FB_MSM_LCDC_PANEL
        default n

config FB_MSM_LCDC_TRULY_HVGA_IPS3P2335_PT_PANEL
        depends on FB_MSM_LCDC_HW
        bool "LCDC Truly HVGA PT Panel"
        select FB_MSM_LCDC_TRULY_HVGA_IPS3P2335
        default n
        


config FB_MSM_LCDC_SAMSUNG_OLED_PT
	bool
	select FB_MSM_LCDC_PANEL
	default n

config FB_MSM_LCDC_NT35582_WVGA
	bool
	select FB_MSM_LCDC_PANEL
	default n

config FB_MSM_LCDC_WXGA
	bool
	select FB_MSM_LCDC_PANEL
	default n

config FB_MSM_LVDS_CHIMEI_WXGA
	bool
	select FB_MSM_LVDS
	default n

config FB_MSM_LVDS_FRC_FHD
	bool
	select FB_MSM_LVDS
	default n

config FB_MSM_MIPI_TOSHIBA_VIDEO_WVGA_PT
	bool
	select FB_MSM_MIPI_DSI_TOSHIBA
	default n

config FB_MSM_MIPI_TOSHIBA_VIDEO_WSVGA_PT
	bool
	select FB_MSM_MIPI_DSI_TOSHIBA
	default n

config FB_MSM_MIPI_TOSHIBA_VIDEO_WUXGA
	bool
	select FB_MSM_MIPI_DSI_TOSHIBA
	default n

config FB_MSM_MIPI_NOVATEK_VIDEO_QHD_PT
	bool
	select FB_MSM_MIPI_DSI_NOVATEK
	default n

config FB_MSM_MIPI_NOVATEK_CMD_QHD_PT
	bool
	select FB_MSM_MIPI_DSI_NOVATEK
	default n

config FB_MSM_MIPI_ORISE_VIDEO_720P_PT
	bool
	select FB_MSM_MIPI_DSI_ORISE
	default n

config FB_MSM_MIPI_ORISE_CMD_720P_PT
	bool
	select FB_MSM_MIPI_DSI_ORISE
	default n

config FB_MSM_MIPI_RENESAS_VIDEO_FWVGA_PT
	bool
	select FB_MSM_MIPI_DSI_RENESAS
	default n

config FB_MSM_MIPI_RENESAS_CMD_FWVGA_PT
	bool
	select FB_MSM_MIPI_DSI_RENESAS
	default n

config FB_MSM_MIPI_NT35510_VIDEO_WVGA_PT
	bool
	select FB_MSM_MIPI_DSI_NT35510
	default n

config FB_MSM_MIPI_NT35510_CMD_WVGA_PT
	bool
	select FB_MSM_MIPI_DSI_NT35510
	default n

config FB_MSM_MIPI_NT35516_VIDEO_QHD_PT
        bool
        select FB_MSM_MIPI_DSI_NT35516
        default n

config FB_MSM_MIPI_NT35516_CMD_QHD_PT
        bool
        select FB_MSM_MIPI_DSI_NT35516
        default n


config FB_MSM_MIPI_CHIMEI_WXGA
	bool "LVDS Chimei WXGA Panel using Toshiba MIPI DSI-to-LVDS bridge."
	select FB_MSM_MIPI_DSI_TC358764_DSI2LVDS
	

config FB_MSM_MIPI_CHIMEI_WUXGA
	bool "LVDS Chimei WUXGA Panel using Toshiba MIPI DSI-to-LVDS bridge."
	select FB_MSM_MIPI_DSI_TC358764_DSI2LVDS
	

config FB_MSM_MIPI_TRULY_VIDEO_WVGA_PT
	bool
	select FB_MSM_MIPI_DSI_TRULY

config FB_MSM_MIPI_SIMULATOR_VIDEO
	bool
	select FB_MSM_MIPI_DSI_SIMULATOR
	default n

config FB_MSM_NO_MDP_PIPE_CTRL
	depends on FB_MSM_OVERLAY
	bool "Do not use mdp_pipe_ctrl"
	

config FB_MSM_OVERLAY0_WRITEBACK
	depends on FB_MSM_OVERLAY
        bool "MDP overlay0 write back mode enable"
	


config FB_MSM_OVERLAY1_WRITEBACK
        depends on FB_MSM_OVERLAY
        bool "MDP overlay1 write back mode enable"
       

config FB_MSM_WRITEBACK_MSM_PANEL
	depends on FB_MSM_OVERLAY
        bool "MDP overlay write back panel enable"

choice
	prompt "LCD Panel"
	default FB_MSM_MDDI_AUTO_DETECT

config FB_MSM_LCDC_PRISM_WVGA_PANEL
	depends on FB_MSM_LCDC_HW
	bool "LCDC Prism WVGA Panel"
	select FB_MSM_LCDC_PRISM_WVGA
	

config FB_MSM_LCDC_SAMSUNG_WSVGA_PANEL
	depends on FB_MSM_LCDC_HW
	bool "LCDC Samsung WSVGA Panel"
	select FB_MSM_LCDC_SAMSUNG_WSVGA
	

config FB_MSM_LCDC_CHIMEI_WXGA_PANEL
	depends on FB_MSM_LCDC_HW
	bool "LCDC Chimei WXGA Panel"
	select FB_MSM_LCDC_CHIMEI_WXGA
	

config FB_MSM_LCDC_GORDON_VGA_PANEL
	depends on FB_MSM_LCDC_HW
	bool "LCDC Gordon VGA Panel"
	select FB_MSM_LCDC_GORDON_VGA
	

config FB_MSM_LCDC_TOSHIBA_WVGA_PT_PANEL
	depends on FB_MSM_LCDC_HW
	bool "LCDC Toshiba WVGA PT Panel"
	select FB_MSM_LCDC_TOSHIBA_WVGA_PT
	

config FB_MSM_LCDC_TOSHIBA_FWVGA_PT_PANEL
	depends on FB_MSM_LCDC_HW
	bool "LCDC Toshiba FWVGA PT Panel"
	select FB_MSM_LCDC_TOSHIBA_FWVGA_PT
	

config FB_MSM_LCDC_SHARP_WVGA_PT_PANEL
	depends on FB_MSM_LCDC_HW
	bool "LCDC Sharp WVGA PT Panel"
	select FB_MSM_LCDC_SHARP_WVGA_PT
	

config FB_MSM_LCDC_AUO_WVGA_PANEL
	depends on FB_MSM_LCDC_HW
	bool "LCDC AUO WVGA Panel"
	select FB_MSM_LCDC_AUO_WVGA
	

config FB_MSM_LCDC_NT35582_PANEL
	depends on FB_MSM_LCDC_HW
	bool "LCDC NT35582 WVGA Panel"
	select FB_MSM_LCDC_NT35582_WVGA
	

config FB_MSM_LCDC_SAMSUNG_OLED_PT_PANEL
	depends on FB_MSM_LCDC_HW
	bool "LCDC Samsung OLED PT Panel"
	select FB_MSM_LCDC_SAMSUNG_OLED_PT
	

config FB_MSM_LVDS_CHIMEI_WXGA_PANEL
        bool "LVDS Chimei WXGA Panel"
        select FB_MSM_LVDS_CHIMEI_WXGA
        

config FB_MSM_LVDS_FRC_FHD_PANEL
	bool "LVDS FRC FHD Panel"
	select FB_MSM_LVDS_FRC_FHD


config FB_MSM_TRY_MDDI_CATCH_LCDC_PRISM
	depends on FB_MSM_LCDC_HW
	bool "MDDI Panel Auto Detect + LCDC Prism WVGA"
	select FB_MSM_MDDI_AUTO_DETECT
	select FB_MSM_LCDC_PRISM_WVGA
	select FB_MSM_LCDC_GORDON_VGA
	select FB_MSM_LCDC_WXGA
	select FB_MSM_LCDC_TOSHIBA_WVGA_PT
	select FB_MSM_LCDC_TOSHIBA_FWVGA_PT
	select FB_MSM_LCDC_SHARP_WVGA_PT
	select FB_MSM_LCDC_ST15_WXGA


config FB_MSM_MIPI_PANEL_DETECT
	bool "MIPI Panel Detect"
	select FB_MSM_MIPI_TOSHIBA_VIDEO_WVGA_PT
	select FB_MSM_MIPI_TOSHIBA_VIDEO_WSVGA_PT
	select FB_MSM_MIPI_TOSHIBA_VIDEO_WUXGA
	select FB_MSM_MIPI_RENESAS_VIDEO_FWVGA_PT
	select FB_MSM_MIPI_RENESAS_CMD_FWVGA_PT
	select FB_MSM_MIPI_TRULY_VIDEO_WVGA_PT
	select FB_MSM_MIPI_NOVATEK_VIDEO_QHD_PT
	select FB_MSM_MIPI_NOVATEK_CMD_QHD_PT
	select FB_MSM_MIPI_NT35510_VIDEO_WVGA_PT
	select FB_MSM_MIPI_NT35510_CMD_WVGA_PT
	select FB_MSM_MIPI_ORISE_VIDEO_720P_PT
	select FB_MSM_MIPI_ORISE_CMD_720P_PT
	select FB_MSM_MIPI_NT35516_VIDEO_QHD_PT
	select FB_MSM_MIPI_NT35516_CMD_QHD_PT
	select FB_MSM_MIPI_SIMULATOR_VIDEO
	select FB_MSM_MIPI_CHIMEI_WXGA
	select FB_MSM_MIPI_CHIMEI_WUXGA
	

config FB_MSM_MDDI_PANEL_AUTO_DETECT
	bool "MDDI Panel Auto Detect"
	select FB_MSM_MDDI_AUTO_DETECT
	

config FB_MSM_LCDC_PANEL_AUTO_DETECT
	bool "LCDC Panel Auto Detect"
	select FB_MSM_LCDC_AUTO_DETECT
	select FB_MSM_LCDC_SAMSUNG_WSVGA
	select FB_MSM_LCDC_AUO_WVGA
	select FB_MSM_LCDC_NT35582_WVGA
	select FB_MSM_LCDC_SAMSUNG_OLED_PT
	

config FB_MSM_LCDC_MIPI_PANEL_AUTO_DETECT
	bool "LCDC + MIPI Panel Auto Detect"
	select FB_MSM_LCDC_AUTO_DETECT
	select FB_MSM_LCDC_SAMSUNG_WSVGA
	select FB_MSM_LCDC_AUO_WVGA
	select FB_MSM_LCDC_SAMSUNG_OLED_PT
	select FB_MSM_LCDC_NT35582_WVGA
	select FB_MSM_LCDC_TOSHIBA_FWVGA_PT
	select FB_MSM_MIPI_TOSHIBA_VIDEO_WVGA_PT
	select FB_MSM_MIPI_TOSHIBA_VIDEO_WSVGA_PT
	select FB_MSM_MIPI_RENESAS_VIDEO_FWVGA_PT
	select FB_MSM_MIPI_RENESAS_CMD_FWVGA_PT
	select FB_MSM_MIPI_NOVATEK_VIDEO_QHD_PT
	select FB_MSM_MIPI_NOVATEK_CMD_QHD_PT
	select FB_MSM_MIPI_NT35510_VIDEO_WVGA_PT
	select FB_MSM_MIPI_NT35510_CMD_WVGA_PT
	select FB_MSM_MIPI_NT35516_VIDEO_QHD_PT
	select FM_MSM_MIPI_NT35516_CMD_QHD_PT
	select FB_MSM_MIPI_SIMULATOR_VIDEO
	

config FB_MSM_LVDS_MIPI_PANEL_DETECT
	bool "LVDS + MIPI Panel Auto Detect"
	select FB_MSM_LVDS_CHIMEI_WXGA
	select FB_MSM_LVDS_FRC_FHD
	select FB_MSM_MIPI_TOSHIBA_VIDEO_WVGA_PT
	select FB_MSM_MIPI_TOSHIBA_VIDEO_WSVGA_PT
	select FB_MSM_MIPI_TOSHIBA_VIDEO_WUXGA
	select FB_MSM_MIPI_RENESAS_VIDEO_FWVGA_PT
	select FB_MSM_MIPI_RENESAS_CMD_FWVGA_PT
	select FB_MSM_MIPI_TRULY_VIDEO_WVGA_PT
	select FB_MSM_MIPI_NOVATEK_VIDEO_QHD_PT
	select FB_MSM_MIPI_NOVATEK_CMD_QHD_PT
	select FB_MSM_MIPI_NT35510_VIDEO_WVGA_PT
	select FB_MSM_MIPI_NT35510_CMD_WVGA_PT
	select FB_MSM_MIPI_ORISE_VIDEO_720P_PT
	select FB_MSM_MIPI_ORISE_CMD_720P_PT
	select FB_MSM_MIPI_SIMULATOR_VIDEO
	select FB_MSM_MIPI_CHIMEI_WXGA
	select FB_MSM_MIPI_CHIMEI_WUXGA
	

config FB_MSM_MDDI_PRISM_WVGA
	bool "MDDI Prism WVGA Panel"
	select FB_MSM_MDDI
	

config FB_MSM_MDDI_TOSHIBA_WVGA_PORTRAIT
	bool "MDDI Toshiba WVGA Portrait Panel"
	select FB_MSM_MDDI_TOSHIBA_COMMON
	
config FB_MSM_MDDI_TOSHIBA_VGA
	bool "MDDI Toshiba VGA Panel"
	select FB_MSM_MDDI_TOSHIBA_COMMON_VGA
	

config FB_MSM_MDDI_TOSHIBA_WVGA
	bool "MDDI Toshiba WVGA panel"
	select FB_MSM_MDDI_TOSHIBA_COMMON
	

config FB_MSM_MDDI_SHARP_QVGA_128x128
	bool "MDDI Sharp QVGA Dual Panel"
	select FB_MSM_MDDI
	

config FB_MSM_MIPI_TOSHIBA_VIDEO_WVGA_PT_PANEL
	bool "MIPI Toshiba WVGA PT Panel"
	select FB_MSM_MIPI_TOSHIBA_VIDEO_WVGA_PT

config FB_MSM_MIPI_TOSHIBA_VIDEO_WSVGA_PT_PANEL
	bool "MIPI Toshiba WSVGA PT Panel"
	select FB_MSM_MIPI_TOSHIBA_VIDEO_WSVGA_PT

config FB_MSM_MIPI_TOSHIBA_VIDEO_WUXGA_PANEL
	bool "MIPI Toshiba WUXGA (1920x1200) Panel"
	select FB_MSM_MIPI_TOSHIBA_VIDEO_WUXGA

config FB_MSM_MIPI_NOVATEK_VIDEO_QHD_PT_PANEL
	bool "MIPI NOVATEK VIDEO QHD PT Panel"
	select FB_MSM_MIPI_NOVATEK_VIDEO_QHD_PT

config FB_MSM_MIPI_NOVATEK_CMD_QHD_PT_PANEL
	bool "MIPI NOVATEK CMD QHD PT Panel"
	select FB_MSM_MIPI_NOVATEK_CMD_QHD_PT

config FB_MSM_MIPI_ORISE_VIDEO_720P_PT_PANEL
	bool "MIPI ORISE VIDEO 720P PT Panel"
	select FB_MSM_MIPI_ORISE_VIDEO_720P_PT

config FB_MSM_MIPI_ORISE_CMD_720P_PT_PANEL
	bool "MIPI ORISE CMD 720P PT Panel"
	select FB_MSM_MIPI_ORISE_CMD_720P_PT

config FB_MSM_MIPI_RENESAS_VIDEO_FWVGA_PT_PANEL
	bool "MIPI Renesas Video FWVGA PT Panel"
	select FB_MSM_MIPI_RENESAS_VIDEO_FWVGA_PT

config FB_MSM_MIPI_RENESAS_CMD_FWVGA_PT_PANEL
	bool "MIPI Renesas Command FWVGA PT Panel"
	select FB_MSM_MIPI_RENESAS_CMD_FWVGA_PT

config FB_MSM_MIPI_CHIMEI_WXGA_PANEL
	bool "MIPI Chimei WXGA PT Panel"
	select FB_MSM_MIPI_CHIMEI_WXGA

config FB_MSM_MIPI_CHIMEI_WUXGA_PANEL
	bool "MIPI Chimei WUXGA Panel"
	select FB_MSM_MIPI_CHIMEI_WUXGA

config FB_MSM_MIPI_TRULY_VIDEO_WVGA_PT_PANEL
	bool "MIPI Truly Video WVGA PT Panel"
	select FB_MSM_MIPI_TRULY_VIDEO_WVGA_PT

config FB_MSM_MIPI_NT35510_VIDEO_WVGA_PT_PANEL
	bool "MIPI NT35510 Video WVGA PT Panel"
	select FB_MSM_MIPI_NT35510_VIDEO_WVGA_PT

config FB_MSM_MIPI_NT35510_CMD_WVGA_PT_PANEL
	bool "MIPI NT35510 Command WVGA PT Panel"
	select FB_MSM_MIPI_NT35510_CMD_WVGA_PT

config FB_MSM_MIPI_NT35516_VIDEO_QHD_PT_PANEL
        bool "MIPI NT35516 Video qHD PT Panel"
        select FB_MSM_MIPI_NT35516_VIDEO_QHD_PT

config FB_MSM_MIPI_NT35516_CMD_QHD_PT_PANEL
        bool "MIPI NT35516 Command qHD PT Panel"
        select FB_MSM_MIPI_NT35516_CMD_QHD_PT

config FB_MSM_MIPI_SIMULATOR_VIDEO_PANEL
	bool "MIPI Simulator Video Panel"
	select FB_MSM_MIPI_SIMULATOR_VIDEO

config FB_MSM_EBI2_TMD_QVGA_EPSON_QCIF
	bool "EBI2 TMD QVGA Epson QCIF Dual Panel"
	select FB_MSM_EBI2


config FB_MSM_HDMI_AS_PRIMARY
	depends on FB_MSM_HDMI_COMMON
	bool "Use HDMI as primary panel"

config FB_MSM_PANEL_NONE
	bool "NONE"
	
endchoice

choice
	prompt "Secondary LCD Panel"
	depends on  FB_MSM_MDP31
	default FB_MSM_SECONDARY_PANEL_NONE

config FB_MSM_LCDC_EXTERNAL_WXGA
	depends on FB_MSM_MDP31
	bool "External WXGA on LCDC"
	select FB_MSM_LCDC_PANEL
	

config FB_MSM_HDMI_SII_EXTERNAL_720P
	depends on FB_MSM_MDP31
	bool "External SiI9022 HDMI 720P"
	select FB_MSM_LCDC_PANEL


config FB_MSM_SECONDARY_PANEL_NONE
	bool "NONE"

endchoice

config FB_MSM_LCDC_DSUB
	depends on FB_MSM_LCDC_SAMSUNG_WSVGA && FB_MSM_MDP40 && FB_MSM_LCDC_HW
	bool "External DSUB support"
	default n
	

config FB_MSM_EXT_INTERFACE_COMMON
	bool
	default n

config FB_MSM_HDMI_COMMON
	bool
	default n

config FB_MSM_HDMI_3D
	bool
	default n

config FB_MSM_HDMI_ADV7520_PANEL
	depends on FB_MSM_MDP40 && FB_MSM_OVERLAY
        bool "LCDC HDMI ADV7520 720p Panel"
        select FB_MSM_DTV
        select FB_MSM_EXT_INTERFACE_COMMON
	select FB_MSM_HDMI_COMMON
	default n
      

config FB_MSM_HDMI_ADV7520_PANEL_HDCP_SUPPORT
        depends on FB_MSM_HDMI_ADV7520_PANEL
        bool "Use HDCP mode"
        default y
        


config FB_MSM_HDMI_MSM_PANEL
	depends on FB_MSM_MDP40
	bool "MSM HDMI 1080p Panel"
	select FB_MSM_DTV
        select FB_MSM_EXT_INTERFACE_COMMON
	select FB_MSM_HDMI_COMMON
	select FB_MSM_HDMI_3D
	default n
	

config FB_MSM_HDMI_MSM_PANEL_DVI_SUPPORT
	depends on FB_MSM_HDMI_MSM_PANEL
	bool "Use DVI mode"
	default n


config FB_MSM_HDMI_MSM_PANEL_CEC_SUPPORT
	depends on FB_MSM_HDMI_MSM_PANEL
	bool "Enable CEC"
	default n
	

config FB_MSM_HDMI_MHL_9244
	depends on FB_MSM_HDMI_MSM_PANEL
	bool 'SI_MHL 9244 support'
	default n
	

config FB_MSM_HDMI_MHL_8334
	depends on FB_MSM_HDMI_MSM_PANEL
	bool 'SI_MHL 8334 support '
	default n
	

choice
	depends on  (FB_MSM_MDP22 || FB_MSM_MDP31 || FB_MSM_MDP40)
	prompt "TVOut Region"
	default FB_MSM_TVOUT_NONE

config FB_MSM_TVOUT_NTSC_M
	bool "NTSC M"
	select FB_MSM_TVOUT
        select FB_MSM_EXT_INTERFACE_COMMON
	

config FB_MSM_TVOUT_NTSC_J
	bool "NTSC J"
	select FB_MSM_TVOUT
        select FB_MSM_EXT_INTERFACE_COMMON
	

config FB_MSM_TVOUT_PAL_BDGHIN
	bool "PAL BDGHIN"
	select FB_MSM_TVOUT
        select FB_MSM_EXT_INTERFACE_COMMON
	

config FB_MSM_TVOUT_PAL_M
	bool "PAL M"
	select FB_MSM_TVOUT
        select FB_MSM_EXT_INTERFACE_COMMON
	

config FB_MSM_TVOUT_PAL_N
	bool "PAL N"
	select FB_MSM_TVOUT
        select FB_MSM_EXT_INTERFACE_COMMON
	

config FB_MSM_TVOUT_NONE
	bool "NONE"
	
endchoice

config FB_MSM_TVOUT_SVIDEO
	bool "TVOut on S-video"
	depends on FB_MSM_TVOUT
	default n
	

choice
	depends on  FB_MSM_MDP22
	prompt "External MDDI"
	default FB_MSM_EXTMDDI_SVGA

config FB_MSM_EXTMDDI_SVGA
	bool "External MDDI SVGA"
	select FB_MSM_MDDI
	select FB_MSM_EXTMDDI
	

config FB_MSM_EXTMDDI_NONE
	bool "NONE"
	
endchoice

choice
	prompt "Default framebuffer color depth"
	depends on FB_MSM_MDP40 || FB_MSM_MDP31 || FB_MSM_MDP303
	default FB_MSM_DEFAULT_DEPTH_RGBA8888

config FB_MSM_DEFAULT_DEPTH_RGB565
	bool "16 bits per pixel (RGB565)"

config FB_MSM_DEFAULT_DEPTH_ARGB8888
	bool "32 bits per pixel (ARGB8888)"

config FB_MSM_DEFAULT_DEPTH_RGBA8888
	bool "32 bits per pixel (RGBA8888)"

endchoice

config FB_MSM_EBI2_EPSON_S1D_QVGA_PANEL
	bool "EBI2 Epson QVGA Panel"
	select FB_MSM_EBI2
	default n


config FB_MSM_EBI2_PANEL_DETECT
	bool "EBI2 Panel Detect"
	select FB_MSM_EBI2_EPSON_S1D_QVGA_PANEL
	default n
	

config FB_MSM_QPIC_ILI_QVGA_PANEL
	bool "Qpic MIPI ILI QVGA Panel"
	select FB_MSM_QPIC
	

config FB_MSM_QPIC_PANEL_DETECT
	bool "Qpic Panel Detect"
	select FB_MSM_QPIC_ILI_QVGA_PANEL
	

if FB_MSM_MDSS
	source "drivers/video/msm/mdss/Kconfig"
endif
endif
```
